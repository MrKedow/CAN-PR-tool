VERSION ""

NS_ :

BS_:
BU_: ECU1 ECU2

BO_ 256 ExampleMsg: 8 ECU1
 SG_ EngineSpeed : 0|16@1+ (1,0) [0|65535] "rpm" Vector__XXX
 SG_ VehicleSpeed : 16|16@1+ (0.1,0) [0|6553.5] "km/h" Vector__XXX
